## arch/arm/configs/ovation_icstp_defconfig
```kconfig
CONFIG_EXPERIMENTAL=y
CONFIG_LOCALVERSION="-00003-OMAP-Android+"
# CONFIG_LOCALVERSION_AUTO is not set
# CONFIG_SWAP is not set
CONFIG_SYSVIPC=y
CONFIG_CGROUPS=y
CONFIG_CGROUP_DEBUG=y
CONFIG_CGROUP_FREEZER=y
CONFIG_CGROUP_CPUACCT=y
CONFIG_RESOURCE_COUNTERS=y
CONFIG_CGROUP_SCHED=y
CONFIG_RT_GROUP_SCHED=y
CONFIG_BLK_DEV_INITRD=y
CONFIG_PANIC_TIMEOUT=5
CONFIG_KALLSYMS_ALL=y
CONFIG_ASHMEM=y
# CONFIG_AIO is not set
CONFIG_EMBEDDED=y
# CONFIG_SLUB_DEBUG is not set
CONFIG_MODULES=y
CONFIG_MODULE_FORCE_LOAD=y
CONFIG_MODULE_UNLOAD=y
CONFIG_MODULE_FORCE_UNLOAD=y
# CONFIG_BLK_DEV_BSG is not set
CONFIG_ARCH_OMAP=y
CONFIG_OMAP_SMARTREFLEX=y
CONFIG_OMAP_SMARTREFLEX_CLASS3=y
CONFIG_OMAP_SMARTREFLEX_CLASS1P5=y
CONFIG_OMAP_RESET_CLOCKS=y
CONFIG_OMAP_TEMP_SENSOR=y
CONFIG_OMAP_REMOTEPROC_MEMPOOL_SIZE=0x0
# CONFIG_ARCH_OMAP2 is not set
# CONFIG_ARCH_OMAP3 is not set
# CONFIG_MACH_OMAP_BLAZE is not set
# CONFIG_MACH_OMAP_ACCLAIM is not set
# CONFIG_MACH_OMAP4_PANDA is not set
CONFIG_MACH_OMAP_OVATION=y
CONFIG_OMAP_ALLOW_OSWR=y
CONFIG_OMAP_RAM_CONSOLE=y
CONFIG_ARM_THUMBEE=y
CONFIG_PL310_ERRATA_727915=y
CONFIG_NO_HZ=y
CONFIG_HIGH_RES_TIMERS=y
CONFIG_SMP=y
# CONFIG_SMP_ON_UP is not set
CONFIG_NR_CPUS=2
CONFIG_PREEMPT=y
CONFIG_HIGHMEM=y
CONFIG_COMPACTION=y
CONFIG_ARM_FLUSH_CONSOLE_ON_RESTART=y
CONFIG_CMDLINE=""
# CONFIG_CMDLINE_EXTEND is not set
CONFIG_CPU_FREQ=y
CONFIG_CPU_FREQ_DEFAULT_GOV_INTERACTIVE=y
CONFIG_CPU_FREQ_GOV_PERFORMANCE=y
CONFIG_CPU_FREQ_GOV_POWERSAVE=y
CONFIG_CPU_FREQ_GOV_USERSPACE=y
CONFIG_CPU_FREQ_GOV_ONDEMAND=y
CONFIG_CPU_FREQ_GOV_CONSERVATIVE=y
CONFIG_CPU_FREQ_GOV_HOTPLUG=y
CONFIG_CPU_IDLE=y
# CONFIG_CORE_DUMP_DEFAULT_ELF_HEADERS is not set
CONFIG_BINFMT_MISC=y
CONFIG_WAKELOCK=y
CONFIG_PM_DEBUG=y
CONFIG_NET=y
CONFIG_PACKET=y
CONFIG_UNIX=y
CONFIG_NET_KEY=y
CONFIG_INET=y
CONFIG_IP_PNP=y
CONFIG_IP_PNP_DHCP=y
CONFIG_INET_ESP=y
# CONFIG_INET_XFRM_MODE_TUNNEL is not set
# CONFIG_INET_XFRM_MODE_BEET is not set
# CONFIG_INET_LRO is not set
CONFIG_IPV6=y
CONFIG_IPV6_PRIVACY=y
CONFIG_IPV6_ROUTER_PREF=y
CONFIG_IPV6_OPTIMISTIC_DAD=y
CONFIG_INET6_AH=y
CONFIG_INET6_ESP=y
CONFIG_INET6_IPCOMP=y
CONFIG_IPV6_MIP6=y
CONFIG_IPV6_TUNNEL=y
CONFIG_IPV6_MULTIPLE_TABLES=y
CONFIG_NETFILTER=y
CONFIG_NETFILTER_NETLINK_LOG=y
CONFIG_NF_CONNTRACK=y
CONFIG_NF_CONNTRACK_EVENTS=y
CONFIG_NF_CT_PROTO_DCCP=y
CONFIG_NF_CT_PROTO_SCTP=y
CONFIG_NF_CT_PROTO_UDPLITE=y
CONFIG_NF_CONNTRACK_AMANDA=y
CONFIG_NF_CONNTRACK_FTP=y
CONFIG_NF_CONNTRACK_H323=y
CONFIG_NF_CONNTRACK_IRC=y
CONFIG_NF_CONNTRACK_NETBIOS_NS=y
CONFIG_NF_CONNTRACK_PPTP=y
CONFIG_NF_CONNTRACK_SANE=y
CONFIG_NF_CONNTRACK_TFTP=y
CONFIG_NF_CT_NETLINK=y
CONFIG_NETFILTER_TPROXY=y
CONFIG_NETFILTER_XT_TARGET_CLASSIFY=y
CONFIG_NETFILTER_XT_TARGET_CONNMARK=y
CONFIG_NETFILTER_XT_TARGET_MARK=y
CONFIG_NETFILTER_XT_TARGET_NFQUEUE=y
CONFIG_NETFILTER_XT_MATCH_COMMENT=y
CONFIG_NETFILTER_XT_MATCH_CONNBYTES=y
CONFIG_NETFILTER_XT_MATCH_CONNLIMIT=y
CONFIG_NETFILTER_XT_MATCH_CONNMARK=y
CONFIG_NETFILTER_XT_MATCH_CONNTRACK=y
CONFIG_NETFILTER_XT_MATCH_HASHLIMIT=y
CONFIG_NETFILTER_XT_MATCH_HELPER=y
CONFIG_NETFILTER_XT_MATCH_IPRANGE=y
CONFIG_NETFILTER_XT_MATCH_LENGTH=y
CONFIG_NETFILTER_XT_MATCH_LIMIT=y
CONFIG_NETFILTER_XT_MATCH_MAC=y
CONFIG_NETFILTER_XT_MATCH_MARK=y
CONFIG_NETFILTER_XT_MATCH_POLICY=y
CONFIG_NETFILTER_XT_MATCH_PKTTYPE=y
CONFIG_NETFILTER_XT_MATCH_QTAGUID=y
CONFIG_NETFILTER_XT_MATCH_QUOTA=y
CONFIG_NETFILTER_XT_MATCH_QUOTA2=y
CONFIG_NETFILTER_XT_MATCH_QUOTA2_LOG=y
CONFIG_NETFILTER_XT_MATCH_SOCKET=y
CONFIG_NETFILTER_XT_MATCH_STATE=y
CONFIG_NETFILTER_XT_MATCH_STATISTIC=y
CONFIG_NETFILTER_XT_MATCH_STRING=y
CONFIG_NETFILTER_XT_MATCH_TIME=y
CONFIG_NETFILTER_XT_MATCH_U32=y
CONFIG_NF_CONNTRACK_IPV4=y
CONFIG_IP_NF_IPTABLES=y
CONFIG_IP_NF_MATCH_AH=y
CONFIG_IP_NF_MATCH_ECN=y
CONFIG_IP_NF_MATCH_TTL=y
CONFIG_IP_NF_FILTER=y
CONFIG_IP_NF_TARGET_REJECT=y
CONFIG_IP_NF_TARGET_LOG=y
CONFIG_NF_NAT=y
CONFIG_IP_NF_TARGET_MASQUERADE=y
CONFIG_IP_NF_TARGET_NETMAP=y
CONFIG_IP_NF_TARGET_REDIRECT=y
CONFIG_IP_NF_MANGLE=y
CONFIG_IP_NF_ARPTABLES=y
CONFIG_IP_NF_ARPFILTER=y
CONFIG_IP_NF_ARP_MANGLE=y
CONFIG_IP6_NF_IPTABLES=y
CONFIG_IP6_NF_TARGET_LOG=y
CONFIG_IP6_NF_FILTER=y
CONFIG_IP6_NF_TARGET_REJECT=y
CONFIG_IP6_NF_MANGLE=y
CONFIG_PHONET=y
CONFIG_NET_SCHED=y
CONFIG_NET_SCH_HTB=y
CONFIG_NET_SCH_INGRESS=y
CONFIG_NET_CLS_U32=y
CONFIG_NET_EMATCH=y
CONFIG_NET_EMATCH_U32=y
CONFIG_NET_CLS_ACT=y
CONFIG_NET_ACT_POLICE=y
CONFIG_NET_ACT_GACT=y
CONFIG_NET_ACT_MIRRED=y
CONFIG_BT=m
CONFIG_BT_L2CAP=y
CONFIG_BT_SCO=y
CONFIG_BT_RFCOMM=m
CONFIG_BT_RFCOMM_TTY=y
CONFIG_BT_BNEP=m
CONFIG_BT_HCIUART=y
#CONFIG_BT_HCIUART_H4=y
#CONFIG_BT_HCIUART_BCSP=y
#CONFIG_BT_HCIUART_LL=y
CONFIG_BT_WILINK=y
CONFIG_BT_HIDP=m
CONFIG_CFG80211=m
CONFIG_NL80211_TESTMODE=y
CONFIG_LIB80211=m
CONFIG_MAC80211=m
CONFIG_MAC80211_LEDS=y
CONFIG_MAC80211_DEBUGFS=y
CONFIG_RFKILL=y
CONFIG_RFKILL_INPUT=y
CONFIG_BLK_DEV_LOOP=y
CONFIG_BLK_DEV_UB=y
CONFIG_BLK_DEV_RAM=y
CONFIG_BLK_DEV_RAM_SIZE=8192
CONFIG_MISC_DEVICES=y
# CONFIG_ANDROID_PMEM is not set
CONFIG_UID_STAT=y
CONFIG_TI_ST=y
# CONFIG_GC_CORE is not set
CONFIG_SCSI=y
CONFIG_BLK_DEV_SD=y
CONFIG_CHR_DEV_SG=y
CONFIG_MD=y
CONFIG_BLK_DEV_DM=y
CONFIG_DM_DEBUG=y
CONFIG_DM_CRYPT=y
CONFIG_DM_UEVENT=y
CONFIG_NETDEVICES=y
CONFIG_IFB=y
# CONFIG_NETDEV_1000 is not set
# CONFIG_NETDEV_10000 is not set
CONFIG_WL12XX_MENU=m
CONFIG_WL12XX=m
CONFIG_WL12XX_SDIO=m
CONFIG_PPP=y
CONFIG_PPP_DEFLATE=y
CONFIG_PPP_BSDCOMP=y
CONFIG_PPP_MPPE=y
CONFIG_PPPOLAC=y
CONFIG_PPPOPNS=y
CONFIG_INPUT_EVDEV=y
CONFIG_INPUT_KEYRESET=y
CONFIG_KEYBOARD_OMAP4=y
# CONFIG_INPUT_MOUSE is not set
CONFIG_INPUT_TOUCHSCREEN=y
CONFIG_TOUCHSCREEN_SYNTM12XX=y
CONFIG_TOUCHSCREEN_QUANTUM_OBP=y
CONFIG_TOUCHSCREEN_FT5X06=y
CONFIG_INPUT_MISC=y
CONFIG_INPUT_KEYCHORD=y
CONFIG_INPUT_TWL6030_PWRBUTTON=y
CONFIG_INPUT_UINPUT=y
CONFIG_INPUT_GPIO=y
CONFIG_INPUT_SFH7741=y
CONFIG_INPUT_CMA3000=y
CONFIG_INPUT_CMA3000_I2C=y
CONFIG_INPUT_BH1780=y
CONFIG_INPUT_TWL6040_HSKEYS=y
# CONFIG_VT is not set
# CONFIG_LEGACY_PTYS is not set
CONFIG_HW_RANDOM=y
CONFIG_I2C_CHARDEV=y
CONFIG_SPI=y
CONFIG_SPI_OMAP24XX=y
CONFIG_GPIO_SYSFS=y
CONFIG_GPIO_TWL4030=y
CONFIG_POWER_SUPPLY=y
CONFIG_TWL6030_BCI_BATTERY=y
CONFIG_CHARGER_BQ2419x=y
CONFIG_BATTERY_BQ27x00=y
CONFIG_BATTERY_BQ27X00_I2C=y
# CONFIG_SENSORS_LM75 is not set
CONFIG_WATCHDOG=y
CONFIG_OMAP_WATCHDOG=y
CONFIG_TWL6030_POWER=y
CONFIG_TWL6030_PWM=y
CONFIG_TWL6030_POWEROFF=y
CONFIG_TWL6030_GPADC=y
CONFIG_REGULATOR_FIXED_VOLTAGE=y
CONFIG_REGULATOR_TWL4030=y
CONFIG_MEDIA_SUPPORT=y
CONFIG_VIDEO_DEV=y
# CONFIG_RC_CORE is not set
# CONFIG_MEDIA_TUNER_SIMPLE is not set
# CONFIG_MEDIA_TUNER_TDA8290 is not set
# CONFIG_MEDIA_TUNER_TDA827X is not set
# CONFIG_MEDIA_TUNER_TDA18271 is not set
# CONFIG_MEDIA_TUNER_TDA9887 is not set
# CONFIG_MEDIA_TUNER_TEA5761 is not set
# CONFIG_MEDIA_TUNER_TEA5767 is not set
# CONFIG_MEDIA_TUNER_MT20XX is not set
# CONFIG_MEDIA_TUNER_MT2060 is not set
# CONFIG_MEDIA_TUNER_MT2266 is not set
# CONFIG_MEDIA_TUNER_MT2131 is not set
# CONFIG_MEDIA_TUNER_QT1010 is not set
# CONFIG_MEDIA_TUNER_XC2028 is not set
# CONFIG_MEDIA_TUNER_XC5000 is not set
# CONFIG_MEDIA_TUNER_MXL5005S is not set
# CONFIG_MEDIA_TUNER_MXL5007T is not set
# CONFIG_MEDIA_TUNER_MC44S803 is not set
# CONFIG_MEDIA_TUNER_MAX2165 is not set
# CONFIG_MEDIA_TUNER_TDA18218 is not set
# CONFIG_MEDIA_TUNER_TDA18212 is not set
# CONFIG_VIDEO_OMAP_GFX is not set
# CONFIG_USB_GSPCA is not set
# CONFIG_RADIO_ADAPTERS is not set
CONFIG_ION=y
CONFIG_ION_OMAP=y
CONFIG_FB=y
CONFIG_OMAP2_DSS=y
#CONFIG_OMAP2_VRAM_SIZE is not set
# CONFIG_OMAP2_DSS_VENC is not set
CONFIG_OMAP2_DSS_DSI=y
CONFIG_FB_OMAP2=y
CONFIG_FB_OMAP2_NUM_FBS=2
CONFIG_PANEL_AUO=y
CONFIG_PANEL_TC358765=y
CONFIG_PANEL_NOVATEK=y
CONFIG_OMAP4_HDCP=y
CONFIG_BACKLIGHT_LCD_SUPPORT=y
CONFIG_LCD_CLASS_DEVICE=y
# CONFIG_BACKLIGHT_GENERIC is not set
CONFIG_BACKLIGHT_LP855X=y
CONFIG_DISPLAY_SUPPORT=y
CONFIG_LOGO=y
CONFIG_SOUND=y
CONFIG_SND=y
CONFIG_SND_USB_AUDIO=y
CONFIG_SND_SOC=y
CONFIG_SND_OMAP_SOC=y
CONFIG_SND_OMAP_SOC_SDP4430=y
CONFIG_SND_OMAP_SOC_OMAP4_HDMI=y
CONFIG_SND_OMAP4_ABE_USE_ALT_FW=y
CONFIG_USB=y
CONFIG_USB_ANNOUNCE_NEW_DEVICES=y
CONFIG_USB_DEVICEFS=y
CONFIG_USB_SUSPEND=y
# CONFIG_USB_OTG_WHITELIST is not set
CONFIG_USB_EHCI_HCD=y
CONFIG_USB_MUSB_HDRC=y
CONFIG_USB_MUSB_OMAP2PLUS=y
CONFIG_USB_MUSB_OTG=y
CONFIG_USB_GADGET_MUSB_HDRC=y
CONFIG_USB_ACM=y
CONFIG_USB_STORAGE=y
CONFIG_USB_SERIAL=y
CONFIG_USB_GADGET=y
CONFIG_USB_GADGET_VBUS_DRAW=500
CONFIG_USB_G_ANDROID=y
CONFIG_USB_OTG_WAKELOCK=y
CONFIG_TWL6030_USB=y
CONFIG_MMC=y
CONFIG_MMC_UNSAFE_RESUME=y
CONFIG_MMC_EMBEDDED_SDIO=y
CONFIG_MMC_PARANOID_SD_INIT=y
CONFIG_MMC_OMAP=y
CONFIG_MMC_OMAP_HS=y
CONFIG_NEW_LEDS=y
CONFIG_LEDS_CLASS=y
CONFIG_LEDS_GPIO=y
CONFIG_LEDS_PWM=y
CONFIG_NFC_DEVICES=y
CONFIG_PN544_NFC=y
CONFIG_SWITCH=y
CONFIG_SWITCH_GPIO=y
CONFIG_RTC_CLASS=y
CONFIG_RTC_DRV_TWL4030=y
CONFIG_STAGING=y
CONFIG_ANDROID=y
CONFIG_ANDROID_BINDER_IPC=y
CONFIG_ANDROID_LOGGER=y
CONFIG_ANDROID_RAM_CONSOLE=y
CONFIG_ANDROID_RAM_CONSOLE_ERROR_CORRECTION=y
CONFIG_ANDROID_TIMED_GPIO=y
CONFIG_ANDROID_LOW_MEMORY_KILLER=y
CONFIG_THERMAL_FRAMEWORK=y
CONFIG_OMAP_THERMAL=y
CONFIG_OMAP4_DIE_TEMP_SENSOR=y
CONFIG_OMAP4_PCB_SENSOR=y
CONFIG_OMAP4_DUTY_CYCLE=y
CONFIG_OMAP_DIE_GOVERNOR=y
CONFIG_HWSPINLOCK=y
CONFIG_HWSPINLOCK_OMAP=y
# CONFIG_RPMSG_CLIENT_SAMPLE is not set
# CONFIG_RPMSG_SERVER_SAMPLE is not set
CONFIG_EXT2_FS=y
CONFIG_EXT4_FS=y
# CONFIG_EXT4_FS_XATTR is not set
# CONFIG_DNOTIFY is not set
CONFIG_FUSE_FS=y
CONFIG_MSDOS_FS=y
CONFIG_VFAT_FS=y
CONFIG_TMPFS=y
CONFIG_TMPFS_POSIX_ACL=y
CONFIG_PARTITION_ADVANCED=y
CONFIG_EFI_PARTITION=y
CONFIG_NLS_CODEPAGE_437=y
CONFIG_NLS_ASCII=y
CONFIG_NLS_ISO8859_1=y
CONFIG_PRINTK_TIME=y
CONFIG_MAGIC_SYSRQ=y
CONFIG_DEBUG_FS=y
CONFIG_DEBUG_KERNEL=y
CONFIG_DETECT_HUNG_TASK=y
# CONFIG_DEBUG_PREEMPT is not set
CONFIG_DEBUG_RT_MUTEXES=y
CONFIG_DEBUG_SPINLOCK=y
CONFIG_DEBUG_MUTEXES=y
CONFIG_DEBUG_SPINLOCK_SLEEP=y
CONFIG_DEBUG_INFO=y
CONFIG_SYSCTL_SYSCALL_CHECK=y
# CONFIG_ARM_UNWIND is not set
CONFIG_DEBUG_USER=y
CONFIG_SECURITY_MIDDLEWARE_COMPONENT=y
CONFIG_CRYPTO_PCBC=y
CONFIG_CRYPTO_MD4=y
CONFIG_CRYPTO_MICHAEL_MIC=y
CONFIG_CRYPTO_SHA256=y
CONFIG_CRYPTO_AES=y
CONFIG_CRYPTO_TWOFISH=y
CONFIG_CRC_CCITT=y
#OTG Mode
CONFIG_HID_SUPPORT=y
CONFIG_USB_HID=y
CONFIG_USB_OTG_WHITELIST=y
# console
CONFIG_VT=y
CONFIG_CONSOLE_TRANSLATIONS=y
CONFIG_VT_CONSOLE=y
CONFIG_DUMMY_CONSOLE=y
CONFIG_FRAMEBUFFER_CONSOLE=y
CONFIG_FONTS=y
CONFIG_FONT_8x16=y
CONFIG_FB_EARLYSUSPEND=y
```

## drivers/gpu/ti/Kconfig
```kconfig
menuconfig TI_GFX_SUPPORT
	tristate "Enable TI GPU components support"
	depends on (ARCH_OMAP5 || ARCH_OMAP4) 
	default y
	help
	  Kernel-level support for TI's GPU components.

source "drivers/gpu/ti/shared_gfx_buf/Kconfig"
```

## drivers/gpu/ti/shared_gfx_buf/Kconfig
```kconfig
menuconfig TI_SHARED_GFX_BUF
	tristate "Enable TI Shared Graphics Buffer Manager"
	select GENERIC_ALLOCATOR
	select DMA_SHARED_BUFFER
	select ION
	select ION_OMAP
	depends on (ARCH_OMAP5 || ARCH_OMAP4) && TI_GFX_SUPPORT
	default y
	help
	  Chose this option to enable Shared Graphics Buffer Manager.
	  The purpose of the manager is to allocate an manage the
	  sharing of graphics buffer resources - allocation, freeing,
	  mapping, un-mapping & low-level synchronization.
```

## drivers/net/wireless/ti/Kconfig
```kconfig
menuconfig WL_TI
	bool "TI Wireless LAN support"
	---help---
	  This section contains support for all the wireless drivers
	  for Texas Instruments WLAN chips, such as wl1251 and the wl12xx
	  family.

if WL_TI
source "drivers/net/wireless/ti/wl1251/Kconfig"
source "drivers/net/wireless/ti/wl12xx/Kconfig"

config WILINK_PLATFORM_DATA
	bool "TI WiLink platform data"
	depends on WL12XX_SDIO || WL1251_SDIO
	default y
	---help---
	Small platform data bit needed to pass data to the sdio modules.


endif # WL_TI
```

## drivers/video/omap2/displays/Kconfig
```kconfig
menu "OMAP2/3 Display Device Drivers"
        depends on OMAP2_DSS

config PANEL_GENERIC_DPI
        tristate "Generic DPI Panel"
	depends on OMAP2_DSS_DPI
        help
	  Generic DPI panel driver.
	  Supports DVI output for Beagle and OMAP3 SDP.
	  Supports LCD Panel used in TI SDP3430 and EVM boards,
	  OMAP3517 EVM boards and CM-T35.

config PANEL_LGPHILIPS_LB035Q02
	tristate "LG.Philips LB035Q02 LCD Panel"
	depends on OMAP2_DSS_DPI && SPI
	help
	  LCD Panel used on the Gumstix Overo Palo35

config PANEL_SHARP_LS037V7DW01
        tristate "Sharp LS037V7DW01 LCD Panel"
        depends on OMAP2_DSS_DPI
        select BACKLIGHT_CLASS_DEVICE
        help
          LCD Panel used in TI's SDP3430 and EVM boards

config PANEL_NEC_NL8048HL11_01B
	tristate "NEC NL8048HL11-01B Panel"
	depends on OMAP2_DSS_DPI
	help
		This NEC NL8048HL11-01B panel is TFT LCD
		used in the Zoom2/3/3630 sdp boards.

config PANEL_S6E8AA0
        tristate "S6E8AA0 DSI Panel"
        depends on OMAP2_DSS_DSI
        help
          S6E8AA0 video mode panel.

config PANEL_TAAL
        tristate "Taal DSI Panel"
        depends on OMAP2_DSS_DSI
        help
          Taal DSI command mode panel from TPO.

config PANEL_TPO_TD043MTEA1
        tristate "TPO TD043MTEA1 LCD Panel"
        depends on OMAP2_DSS_DPI && SPI
        help
          LCD Panel used in OMAP3 Pandora

config PANEL_ACX565AKM
	tristate "ACX565AKM Panel"
	depends on OMAP2_DSS_SDI && SPI
	select BACKLIGHT_CLASS_DEVICE
	help
	  This is the LCD panel used on Nokia N900

config PANEL_TC358765
	tristate "Toshiba TC358765 DSI-2-LVDS chip"
	depends on OMAP2_DSS_DSI && I2C
	select BACKLIGHT_CLASS_DEVICE
	help
	  Toshiba TC358765 DSI-2-LVDS chip with 1024x768 panel

config PANEL_LD089WU1
	tristate "LG LD089WU1 panel"
	depends on OMAP2_DSS_DSI && I2C
	select BACKLIGHT_CLASS_DEVICE
	help
	  LG LD089WU1 panel with WUXGA resolution.

config TC358765_DEBUG
	bool "Toshiba TC358765 DSI-2-LVDS chip debug"
	depends on PANEL_TC358765 && DEBUG_FS
	help
	  Support of TC358765 DSI-2-LVDS chip register access via debugfs

config PANEL_LTN
	tristate "Samsung LTN070NL01/LTN101AL03 Panel"
	depends on OMAP2_DSS_DPI
	default n
	help
	  This enables support for Samsung LTN070NL01/LTN101AL03 LCD panel

config PANEL_TC358765_BOXER
	tristate "Toshiba TC358765 DSI-2-LVDS chip with Acclaim boxer panel"
	depends on OMAP2_DSS_DSI && I2C && SPI
	select BACKLIGHT_CLASS_DEVICE
	help
	  Toshiba TC358765 DSI-2-LVDS chip with boxer panel

config PANEL_BOXER
	tristate "Boxer DLP Panel"
	depends on OMAP2_DSS
	help
	  LCD Panel used in BN Acclaim

config PANEL_AUO
	tristate "AUO DLP Panel"
	depends on OMAP2_DSS
	help
	  LCD Panel used in BN Ovation

config PANEL_HYDIS
	tristate "Hydis HV080X01-100 panel"
	depends on OMAP2_DSS
        select BACKLIGHT_CLASS_DEVICE
	help
	  Hydis panel HV080X01-100

config PANEL_ORISE
	tristate "Orise based TCON display panel"
	depends on OMAP2_DSS_DSI
	help
	  Say yes here if you have an Orise TCON based panel.

config PANEL_NOVATEK
	tristate "Novatek based TCON display panel"
	depends on OMAP2_DSS_DSI
	help
	  Say yes here if you have a Novatek TCON based panel.

endmenu
```

## drivers/video/omap2/omaplfb/Kconfig
```kconfig
config OMAPLFB
        tristate "OMAPLFB support: interface between display and kernel side PowerVR graphics driver"
        depends on OMAP2_DSS && DSSCOMP
	default n
	help
	  Support for in-kernel or modular omaplfb. This is used by PVR kernel module.
```
